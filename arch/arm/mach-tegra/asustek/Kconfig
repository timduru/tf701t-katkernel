## arch/arm/mach-tegra/asustek/Kconfig
```kconfig
config MACH_ASUSTEK
	bool

menu "ASUSTek Board Selection"
source "arch/arm/mach-tegra/asustek/Kconfig.board"
endmenu


menu "ASUSTek Specific Feature"

config ASUSTEK_PCBID
	bool "Support PCBID interface"
	default y
	depends on MACH_ASUSTEK
	help
		PCBID interfaces to support multiple board/peripheral/RF
		configurations

endmenu
```

## arch/arm/mach-tegra/asustek/Kconfig.board
```kconfig
#
# Include the specific Kconfig file for ASUSTek boards
#

config MACH_ASUSTEK_DUMMY
	depends on ARCH_TEGRA_11x_SOC
	select MACH_ASUSTEK
	bool "NONE (No device)"
	help
	  Support for ASUSTek dummy device.

config MACH_MOZART
       bool "Mozart board"
       depends on ARCH_TEGRA_11x_SOC
       select MACH_HAS_SND_SOC_TEGRA_RT5639 if SND_SOC
       select MACH_HAS_SND_SOC_TEGRA_RT5640 if SND_SOC
       select EDP_FRAMEWORK
       help
         Support for NVIDIA MOZART development platform

config MACH_HAYDN
       bool "Haydn board"
       depends on ARCH_TEGRA_11x_SOC
       select MACH_HAS_SND_SOC_TEGRA_RT5639 if SND_SOC
       select MACH_HAS_SND_SOC_TEGRA_RT5640 if SND_SOC
       select EDP_FRAMEWORK
       help
         Support for NVIDIA HAYDN development platform
```

## drivers/net/wireless/bcm43xx/Kconfig
```kconfig
config BCM43XX
	tristate "Broadcom 4334/241 wireless cards support"
	depends on MMC
	---help---
	  This module adds support for wireless adapters based on
	  Broadcom 4329/30 chipset.

	  This driver uses the kernel's wireless extensions subsystem.

	  If you choose to build a module, it'll be called dhd. Say M if
	  unsure.

config BCM43XX_FW_PATH
	depends on BCM43XX
	string "Firmware path"
	default "/system/etc/firmware/fw_bcmdhd.bin"
	---help---
	  Path to the firmware file.

config BCM43XX_NVRAM_PATH
	depends on BCM43XX
	string "NVRAM path"
	default "/system/etc/wifi/bcmdhd.cal"
	---help---
	  Path to the calibration file.

config BCM43XX_WIFI_CONTROL_FUNC
	bool "Use bcmdhd_wlan device"
	depends on BCM43XX
	default n
	---help---
	  Use this option to get various parameters from architecture specific
	  bcmdhd_wlan platform device. Say n if unsure.

config BCM43XX_WEXT
	bool "Enable WEXT support"
	depends on BCM43XX && CFG80211 = n
	select WIRELESS_EXT
	select WEXT_PRIV
	help
	  Enables WEXT support

config DHD_USE_STATIC_BUF
	bool "Enable memory preallocation"
	depends on BCM43XX
	default n
	---help---
	  Use memory preallocated in platform

config DHD_USE_SCHED_SCAN
	bool "Use CFG80211 sched scan"
	depends on BCM43XX && CFG80211
	default n
	---help---
	  Use CFG80211 sched scan

config BCM43XX_EDP_SUPPORT
	bool "BCM43XX EDP Support"
	depends on BCM43XX && EDP_FRAMEWORK
	help
	  Use BCM43XX EDP Support to register the driver to
	  battery edp manager.
```
